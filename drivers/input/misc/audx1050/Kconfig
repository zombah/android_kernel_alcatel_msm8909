## drivers/input/misc/audx1050/Kconfig
```kconfig
config SENSORS_PSENSOR
        tristate "P-sensor"
        help
          Say Y here to enable support for the P-sensor

          To compile this driver as a module, choose M here: the module will
          be called P-sensor.
```

## drivers/input/misc/hall/Kconfig
```kconfig
config SENSORS_HALL
    bool "Hall Sensor"
    help
      Say Y here to enable support for the hall sensor
```

## drivers/input/misc/kxtj9_tct/Kconfig
```kconfig
config SENSORS_KXTJ9_TCT
	tristate "KXTJ9 device driver"
	depends on I2C
	default n
	help
	  Say Y here you want to enable for the sitronix KXTJ9
	  driver.

	  To compile this driver as a module, choose M here: the
	  module will be called KXTJ9.
```

## drivers/input/misc/pixi35/Kconfig
```kconfig
#
# Input misc drivers configuration
#

config SENSORS_BMG160
	tristate "BMG160 gyroscope sensor driver"
	depends on I2C
	help
	  Say Y here if you want to enable the bmg160 gyroscope sensor
	  driver.
	  To compile this driver as a module, choose M here: the
	  module will be called bmg160.

config SENSORS_TSL277X
	tristate "TAOS TSL/TMD2x71 and TSL/TMD2x72 Family of light and proximity sensors"
	depends on I2C
	help
	 Support for: tsl2571, tsl2671, tmd2671, tsl2771, tmd2771, tsl2572, tsl2672,
	 tmd2672, tsl2772, tmd2772 devices.
	 Provides iio_events and direct access via sysfs.

config SENSORS_AKM09911
	tristate "AKM09911 3-axis electronic compass sensor driver"
	depends on I2C
	help
	  Say Y here if you want to enable the akm09911 ecompass sensor
	  driver.

	  To compile this driver as a module, choose M here: the
	  module will be called akm09911.

config SENSORS_BMA2X2
	tristate "BMA2x2 acceleration sensor support"
	depends on I2C
	help
	  If you say yes here, you get support for Bosch Sensortec's
	  acceleration sensors BMA255/BMA254/BMA355/BMA250E/BMA222E/BMA280.

config SENSORS_BMA2X2_ENABLE_INT1
	tristate "BMA2X2 acceleration sensor interrupt INT1 support"
	depends on SENSORS_BMA2X2
	help
	 If you say yes here, you get INT1 support for Bosch Sensortec
	 acceleration sensors BMA255/BMA254/BMA355/BMA250E/BMA222E/BMA280.
	 Select it will disable interrupt INT2 support

config SENSORS_BMA2X2_ENABLE_INT2
	tristate "BMA2X2 acceleration sensor interrupt INT2 support"
	depends on SENSORS_BMA2X2 && !SENSORS_BMA2X2_ENABLE_INT1
	help
	 If you say yes here, you get INT2 support for Bosch Sensortec
	 acceleration sensors BMA255/BMA254/BMA355/BMA250E/BMA222E/BMA280.
	 Can only open if you do NOT open interrupt INT1 support

config SIG_MOTION
	tristate "support significant motion sensor function"
	depends on SENSORS_BMA2X2  && ( SENSORS_BMA2X2_ENABLE_INT1 || SENSORS_BMA2X2_ENABLE_INT2)
	help
	 If you say yes here, if you want to support Bosch significant motion sensor function

config DOUBLE_TAP
	tristate "support double tap sensor function"
	depends on SENSORS_BMA2X2  && ( SENSORS_BMA2X2_ENABLE_INT1 || SENSORS_BMA2X2_ENABLE_INT2)
	help
	 If you say yes here, you get support Bosch double tap sensor function

config SENSORS_BMI058
	tristate "BMI058 Sensor Support"
	depends on (SENSORS_BMG || SENSORS_BMA2X2)
	help
	 If you say yes here, you get support for Bosch Sensortec's
	 sensor driver of BMI058.
```

## drivers/input/misc/pixi355/Kconfig
```kconfig
#
# Input misc drivers configuration
#

config SENSORS_HALL
	tristate "Hall sensor"
	default n
	help
         Say Y here to enable support for the Hall sensor
         To compile this driver as a module, choose M here: the module will
         be called hall_sensor.

config SENSORS_STK3X1X
	tristate "STK3X1X proximity and ambient light sensor"
	depends on I2C
	default n
	help
	  Say Y here you want to enable for the sitronix stk3x1x
	  light and proximity sensors driver.

	  To compile this driver as a module, choose M here: the
	  module will be called stk3x1x.

config SENSORS_AKM09911
	tristate "AKM09911 3-axis electronic compass sensor driver"
	depends on I2C
	help
	  Say Y here if you want to enable the akm09911 ecompass sensor
	  driver.

	  To compile this driver as a module, choose M here: the
	  module will be called akm09911.

config SENSORS_ST480
        tristate "ST480 3-axis electronic compass sensor driver"
        depends on I2C
        help
          Say Y here if you want to enable the st480 ecompass sensor
          driver.

          To compile this driver as a module, choose M here: the
          module will be called st480.

config SENSORS_BMA2X2
	tristate "BMA2x2 acceleration sensor support"
	depends on I2C
	help
	  If you say yes here, you get support for Bosch Sensortec's
	  acceleration sensors BMA255/BMA254/BMA355/BMA250E/BMA222E/BMA280.

config SENSORS_BMA2X2_ENABLE_INT1
	tristate "BMA2X2 acceleration sensor interrupt INT1 support"
	depends on SENSORS_BMA2X2
	help
	 If you say yes here, you get INT1 support for Bosch Sensortec
	 acceleration sensors BMA255/BMA254/BMA355/BMA250E/BMA222E/BMA280.
	 Select it will disable interrupt INT2 support

config SENSORS_BMA2X2_ENABLE_INT2
	tristate "BMA2X2 acceleration sensor interrupt INT2 support"
	depends on SENSORS_BMA2X2 && !SENSORS_BMA2X2_ENABLE_INT1
	help
	 If you say yes here, you get INT2 support for Bosch Sensortec
	 acceleration sensors BMA255/BMA254/BMA355/BMA250E/BMA222E/BMA280.
	 Can only open if you do NOT open interrupt INT1 support

config SIG_MOTION
	tristate "support significant motion sensor function"
	depends on SENSORS_BMA2X2  && ( SENSORS_BMA2X2_ENABLE_INT1 || SENSORS_BMA2X2_ENABLE_INT2)
	help
	 If you say yes here, if you want to support Bosch significant motion sensor function

config DOUBLE_TAP
	tristate "support double tap sensor function"
	depends on SENSORS_BMA2X2  && ( SENSORS_BMA2X2_ENABLE_INT1 || SENSORS_BMA2X2_ENABLE_INT2)
	help
	 If you say yes here, you get support Bosch double tap sensor function

config SENSORS_BMI058
	tristate "BMI058 Sensor Support"
	depends on (SENSORS_BMG || SENSORS_BMA2X2)
	help
	 If you say yes here, you get support for Bosch Sensortec's
	 sensor driver of BMI058.
```

## drivers/input/misc/pixi445_tf/Kconfig
```kconfig
#
# Input misc drivers configuration
#

config SENSORS_STK3X1X
	tristate "STK3X1X proximity and ambient light sensor"
	depends on I2C
	default n
	help
	  Say Y here you want to enable for the sitronix stk3x1x
	  light and proximity sensors driver.

	  To compile this driver as a module, choose M here: the
	  module will be called stk3x1x.

# mCube start
config SENSORS_MC3XXX
	tristate "MC3XXX G-sensor support"
	default y
	depends on I2C
	help
	  If you say yes here you get support for mCube's
	  G-sensor MC3XXX.
# mCube end
```

## drivers/input/misc/stk3x1x_tct/Kconfig
```kconfig
config SENSORS_STK3X1X_TCT
	tristate "STK3311 device driver"
	depends on I2C
	default n
	help
	  Say Y here you want to enable for the sitronix stk3x1x
	  light and proximity sensors driver.

	  To compile this driver as a module, choose M here: the
	  module will be called stk3x1x.
```

## drivers/input/touchscreen/gt9157_pixi355/Kconfig
```kconfig
#[PLATFORM]-Add-BEGIN by Luoxingxing for gt9157 driver code.[2015.04.16]
config TOUCHSCREEN_GT9157            
       tristate "GT9157 touchscreen"
	default n
       depends on I2C
       help
         Say Y here if you have a GT9157 touchscreen on TCL PIXI3-55.
         If unsure, say N.
         To compile this driver as a module, choose M here: the
         module will be called GT9157.
#[PLATFORM]-Add-END by Luoxingxing
```

## drivers/input/touchscreen/msg2238_pixi35/Kconfig
```kconfig
#[PLATFORM]-Add-BEGIN by mike.li for msg2238 driver code.[2015.03.06]
config TOUCHSCREEN_MSG2238            
       tristate "MSG2238 touchscreen"
	default n
       depends on I2C
       help
         Say Y here if you have a MSG2238 touchscreen on TCL PIXI3.
         If unsure, say N.
         To compile this driver as a module, choose M here: the
         module will be called MSG2238.
#[PLATFORM]-Add-END by mike.li
```

## drivers/input/touchscreen/pixi35/Kconfig
```kconfig
#
# Touchscreen driver configuration
#

config TOUCHSCREEN_FT5X06
       tristate "FocalTech touchscreens"
       depends on I2C
       help
         Say Y here if you have a ft5X06 touchscreen.
	 Ft5x06 controllers are multi touch controllers which can
	 report 5 touches at a time.

         If unsure, say N.

         To compile this driver as a module, choose M here: the
         module will be called ft5x06_ts.
```

## drivers/input/touchscreen/s2333_pixi355/Kconfig
```kconfig
#
# Synaptics DSX touchscreen driver configuration
#

#[PLATFORM]-Add-BEGIN by mike.li for s2333 driver code.[2015.05.21]
config TOUCHSCREEN_SYNAPTICS_DSX_PIXI355            
	bool "Synaptics DSX touchscreen"
	default n
	help
	  Say Y here if you have a Synaptics DSX touchscreen connected
	  to your system.

	  If unsure, say N.
#[PLATFORM]-Add-END by mike.li
```
