/* Copyright (c) 2014, The Linux Foundation. All rights reserved.
 *
 * This program is free software; you can redistribute it and/or modify
 * it under the terms of the GNU General Public License version 2 and
 * only version 2 as published by the Free Software Foundation.
 *
 * This program is distributed in the hope that it will be useful,
 * but WITHOUT ANY WARRANTY; without even the implied warranty of
 * MERCHANTABILITY or FITNESS FOR A PARTICULAR PURPOSE.  See the
 * GNU General Public License for more details.
 */

/*---------------------------------------------------------------------------
 * This file is autogenerated file using gcdb parser. Please do not edit it.
 * Update input XML file to add a new entry or update variable in this file
 * VERSION = "1.0"
 *---------------------------------------------------------------------------*/
&mdss_mdp {
	dsi_hx8279a_txd_boe_wsvga_video: qcom,mdss_dsi_hx8279a_txd_boe_wsvga_video {
		qcom,mdss-dsi-panel-name = "HX8279A TXD BOE wsvga video mode dsi panel";
		qcom,mdss-dsi-panel-controller = <&mdss_dsi0>;
		qcom,mdss-dsi-panel-type = "dsi_video_mode";
		qcom,mdss-dsi-panel-destination = "display_1";
		qcom,mdss-dsi-panel-framerate = <60>;
		qcom,mdss-dsi-virtual-channel-id = <0>;
		qcom,mdss-dsi-stream = <0>;
		qcom,mdss-dsi-panel-width = <600>;
		qcom,mdss-dsi-panel-height = <1024>;
		qcom,mdss-dsi-h-front-porch = <100>;
		qcom,mdss-dsi-h-back-porch = <36>;
		qcom,mdss-dsi-h-pulse-width = <24>;
		qcom,mdss-dsi-h-sync-skew = <0>;
		qcom,mdss-dsi-v-back-porch = <8>;
		qcom,mdss-dsi-v-front-porch = <22>;
		qcom,mdss-dsi-v-pulse-width = <2>;
		qcom,mdss-dsi-h-left-border = <0>;
		qcom,mdss-dsi-h-right-border = <0>;
		qcom,mdss-dsi-v-top-border = <0>;
		qcom,mdss-dsi-v-bottom-border = <0>;
		qcom,mdss-dsi-bpp = <24>;
		qcom,mdss-dsi-color-order = "rgb_swap_rgb";
		qcom,mdss-dsi-underflow-color = <0xff>;
		qcom,mdss-dsi-border-color = <0>;
		qcom,mdss-dsi-on-command = [
			15 01 00 00 00 00 02 B0 00
                        15 01 00 00 00 00 02 BA A4
			15 01 00 00 00 00 02 BD 71
                        15 01 00 00 00 00 02 BE 00
			15 01 00 00 00 00 02 BF 19
			15 01 00 00 00 00 02 C0 10
                        15 01 00 00 00 00 02 C1 78
                        15 01 00 00 00 00 02 C2 5C
                        15 01 00 00 00 00 02 C3 E8
			15 01 00 00 00 00 02 C4 73
			15 01 00 00 00 00 02 C5 05
			15 01 00 00 00 00 02 C6 02
			15 01 00 00 00 00 02 C7 05
			15 01 00 00 00 00 02 C8 03
			15 01 00 00 00 00 02 C9 18
                        15 01 00 00 00 00 02 CA 00
                        15 01 00 00 00 00 02 CB 00
			15 01 00 00 00 00 02 B0 01
			15 01 00 00 00 00 02 B1 00
			15 01 00 00 00 00 02 B2 2c
			15 01 00 00 00 00 02 B3 5c
			15 01 00 00 00 00 02 B4 ac
			15 01 00 00 00 00 02 B5 dc
			15 01 00 00 00 00 02 B6 5c
                        15 01 00 00 00 00 02 B7 90
                        15 01 00 00 00 00 02 B8 C0
			15 01 00 00 00 00 02 B9 0c
                        15 01 00 00 00 00 02 BA 3C
			15 01 00 00 00 00 02 BB 6c
                        15 01 00 00 00 00 02 BC 9B
                        15 01 00 00 00 00 02 BD CA
                        15 01 00 00 00 00 02 BE F6
                        15 01 00 00 00 00 02 BF 24
                        15 01 00 00 00 00 02 C0 4E
                        15 01 00 00 00 00 02 C1 9D
			15 01 00 00 00 00 02 C2 00
			15 01 00 00 00 00 02 C3 15
			15 01 00 00 00 00 02 C4 AA
			15 01 00 00 00 00 02 C5 AF
			15 01 00 00 00 00 02 C6 03
			15 01 00 00 00 00 02 C7 00
			15 01 00 00 00 00 02 C8 2c
			15 01 00 00 00 00 02 C9 5c
			15 01 00 00 00 00 02 CA ac
			15 01 00 00 00 00 02 CB dc
			15 01 00 00 00 00 02 CC 5c
			15 01 00 00 00 00 02 CD 9c
			15 01 00 00 00 00 02 CE cc
			15 01 00 00 00 00 02 CF 0c
			15 01 00 00 00 00 02 D0 3c
			15 01 00 00 00 00 02 D1 6c
                        15 01 00 00 00 00 02 D2 9B
                        15 01 00 00 00 00 02 D3 CA
                        15 01 00 00 00 00 02 D4 F6
                        15 01 00 00 00 00 02 D5 24
                        15 01 00 00 00 00 02 D6 4E
                        15 01 00 00 00 00 02 D7 9D
			15 01 00 00 00 00 02 D8 00
			15 01 00 00 00 00 02 D9 15
			15 01 00 00 00 00 02 DA AA
			15 01 00 00 00 00 02 DB AF
			15 01 00 00 00 00 02 DC 03
			15 01 00 00 00 00 02 DD 00
			15 01 00 00 00 00 02 DE 2c
			15 01 00 00 00 00 02 DF 5c
			15 01 00 00 00 00 02 E0 ac
			15 01 00 00 00 00 02 E1 dc
			15 01 00 00 00 00 02 E2 5c
			15 01 00 00 00 00 02 E3 9c
			15 01 00 00 00 00 02 E4 cc
			15 01 00 00 00 00 02 E5 0c
			15 01 00 00 00 00 02 E6 3c
			15 01 00 00 00 00 02 E7 6c
                        15 01 00 00 00 00 02 E8 9B
                        15 01 00 00 00 00 02 E9 CA
                        15 01 00 00 00 00 02 EA F6
                        15 01 00 00 00 00 02 EB 24
                        15 01 00 00 00 00 02 EC 4E
                        15 01 00 00 00 00 02 ED 9D
			15 01 00 00 00 00 02 EE 00
			15 01 00 00 00 00 02 EF 15
			15 01 00 00 00 00 02 F0 AA
			15 01 00 00 00 00 02 F1 AF
			15 01 00 00 00 00 02 F2 03
			15 01 00 00 00 00 02 B0 02
			15 01 00 00 00 00 02 B1 00
			15 01 00 00 00 00 02 B2 2c
			15 01 00 00 00 00 02 B3 5c
			15 01 00 00 00 00 02 B4 ac
                        15 01 00 00 00 00 02 B5 CC
                        15 01 00 00 00 00 02 B6 4C
                        15 01 00 00 00 00 02 B7 80
                        15 01 00 00 00 00 02 B8 B0
                        15 01 00 00 00 00 02 B9 03
                        15 01 00 00 00 00 02 BA 2C
                        15 01 00 00 00 00 02 BB 5C
                        15 01 00 00 00 00 02 BC 8B
                        15 01 00 00 00 00 02 BD BA
                        15 01 00 00 00 00 02 BE E6
                        15 01 00 00 00 00 02 BF 14
                        15 01 00 00 00 00 02 C0 4E
                        15 01 00 00 00 00 02 C1 9D
			15 01 00 00 00 00 02 C2 00
			15 01 00 00 00 00 02 C3 15
			15 01 00 00 00 00 02 C4 AA
			15 01 00 00 00 00 02 C5 AF
			15 01 00 00 00 00 02 C6 03
			15 01 00 00 00 00 02 C7 00
			15 01 00 00 00 00 02 C8 2c
			15 01 00 00 00 00 02 C9 5c
			15 01 00 00 00 00 02 CA ac
			15 01 00 00 00 00 02 CB dc
			15 01 00 00 00 00 02 CC 5c
			15 01 00 00 00 00 02 CD 9c
			15 01 00 00 00 00 02 CE cc
			15 01 00 00 00 00 02 CF 0c
			15 01 00 00 00 00 02 D0 3c
			15 01 00 00 00 00 02 D1 6c
                        15 01 00 00 00 00 02 D2 9B
                        15 01 00 00 00 00 02 D3 CA
                        15 01 00 00 00 00 02 D4 F6
                        15 01 00 00 00 00 02 D5 24
                        15 01 00 00 00 00 02 D6 4E
                        15 01 00 00 00 00 02 D7 9D
			15 01 00 00 00 00 02 D8 00
			15 01 00 00 00 00 02 D9 15
			15 01 00 00 00 00 02 DA AA
			15 01 00 00 00 00 02 DB AF
			15 01 00 00 00 00 02 DC 03
			15 01 00 00 00 00 02 DD 00
			15 01 00 00 00 00 02 DE 2c
			15 01 00 00 00 00 02 DF 5c
			15 01 00 00 00 00 02 E0 ac
			15 01 00 00 00 00 02 E1 dc
			15 01 00 00 00 00 02 E2 5c
			15 01 00 00 00 00 02 E3 9c
			15 01 00 00 00 00 02 E4 cc
			15 01 00 00 00 00 02 E5 0c
			15 01 00 00 00 00 02 E6 3c
			15 01 00 00 00 00 02 E7 6c
                        15 01 00 00 00 00 02 E8 9B
                        15 01 00 00 00 00 02 E9 CA
                        15 01 00 00 00 00 02 EA F6
                        15 01 00 00 00 00 02 EB 24
                        15 01 00 00 00 00 02 EC 4E
                        15 01 00 00 00 00 02 ED 9D
			15 01 00 00 00 00 02 EE 00
			15 01 00 00 00 00 02 EF 15
			15 01 00 00 00 00 02 F0 AA
			15 01 00 00 00 00 02 F1 AF
			15 01 00 00 00 00 02 F2 03
			15 01 00 00 00 00 02 B0 03
			15 01 00 00 00 00 02 C0 40
			15 01 00 00 00 00 02 C1 10
			15 01 00 00 00 00 02 C4 2F
			15 01 00 00 00 00 02 C5 9E
			15 01 00 00 00 00 02 C8 41
			15 01 00 00 00 00 02 C9 61
			15 01 00 00 00 00 02 CA 01
			15 01 00 00 00 00 02 CB 00
			15 01 00 00 00 00 02 DC 01
			15 01 00 00 00 00 02 DD 07
			15 01 00 00 00 00 02 DE 05
			15 01 00 00 00 00 02 DF 00
			15 01 00 00 00 00 02 E0 00
			15 01 00 00 00 00 02 E1 00
			15 01 00 00 00 00 02 E2 00
			15 01 00 00 00 00 02 E3 00
			15 01 00 00 00 00 02 E4 00
			15 01 00 00 00 00 02 E5 00
			15 01 00 00 00 00 02 E6 00
			15 01 00 00 00 00 02 E7 00
			15 01 00 00 00 00 02 E8 00
			15 01 00 00 00 00 02 E9 00
			15 01 00 00 00 00 02 EA 00
			15 01 00 00 00 00 02 EB 00
			15 01 00 00 00 00 02 EC 02
			15 01 00 00 00 00 02 ED 08
			15 01 00 00 00 00 02 EE 06
			15 01 00 00 00 00 02 EF 00
			15 01 00 00 00 00 02 F0 00
			15 01 00 00 00 00 02 F1 00
			15 01 00 00 00 00 02 F2 00
			15 01 00 00 00 00 02 F3 00
			15 01 00 00 00 00 02 F4 00
			15 01 00 00 00 00 02 F5 00
			15 01 00 00 00 00 02 F6 00
			15 01 00 00 00 00 02 F7 00
			15 01 00 00 00 00 02 F8 00
			15 01 00 00 00 00 02 F9 00
			15 01 00 00 00 00 02 FA 00
			15 01 00 00 00 00 02 FB 00
			15 01 00 00 00 00 02 B0 05
			15 01 00 00 00 00 02 B3 52
			15 01 00 00 00 00 02 B0 06
			15 01 00 00 00 00 02 B8 A5
			15 01 00 00 00 00 02 C0 A5
                        15 01 00 00 00 00 02 B5 0F
			15 01 00 00 00 00 02 C7 1F
			15 01 00 00 00 00 02 CE 4F
			15 01 00 00 00 00 02 B8 5A
			15 01 00 00 00 00 02 C0 5A
                        15 01 00 00 00 00 02 CA 0B
			15 01 00 00 00 00 02 B0 03
			15 01 00 00 00 00 02 B2 A5
			15 01 00 00 00 00 02 B3 04
			15 01 00 00 00 00 02 B0 0F
                        15 01 00 00 00 00 02 35 01
			05 01 00 00 80 00 02 11 00
			05 01 00 00 00 00 02 29 00];
		qcom,mdss-dsi-off-command = [05 01 00 00 32 00 02 28 00
					05 01 00 00 78 00 02 10 00];
		qcom,mdss-dsi-on-command-state = "dsi_lp_mode";
		qcom,mdss-dsi-off-command-state = "dsi_lp_mode";
		qcom,mdss-dsi-h-sync-pulse = <1>;
		qcom,mdss-dsi-traffic-mode = "burst_mode";
		qcom,mdss-dsi-lane-map = "lane_map_0123";
		qcom,mdss-dsi-bllp-eof-power-mode;
		qcom,mdss-dsi-bllp-power-mode;
		qcom,mdss-dsi-lane-0-state;
		qcom,mdss-dsi-lane-1-state;
		qcom,mdss-dsi-lane-2-state;
		qcom,mdss-dsi-lane-3-state;
		qcom,mdss-dsi-panel-timings = [5F 12 0A 00 32 34 10 16 0F 03 04 00];
		qcom,mdss-dsi-t-clk-post = <0x05>;
		qcom,mdss-dsi-t-clk-pre = <0x15>;
		qcom,mdss-dsi-bl-min-level = <1>;
		qcom,mdss-dsi-bl-max-level = <255>;
		qcom,mdss-dsi-dma-trigger = "trigger_sw";
		qcom,mdss-dsi-mdp-trigger = "none";
		qcom,mdss-dsi-bl-pmic-control-type = "bl_ctrl_pwm";
		qcom,mdss-dsi-bl-pmic-pwm-frequency = <33>;
		qcom,mdss-dsi-bl-pmic-bank-select = <0>;
		qcom,mdss-dsi-pwm-gpio = <&pm8909_mpps 2 0>;
		qcom,mdss-dsi-reset-sequence = <0 20>, <0 0>, <1 200>;
		qcom,cont-splash-enabled;
	};
};
