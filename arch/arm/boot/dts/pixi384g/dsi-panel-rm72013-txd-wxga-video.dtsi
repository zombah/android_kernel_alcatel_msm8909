/* Copyright (c) 2014, The Linux Foundation. All rights reserved.
 *
 * This program is free software; you can redistribute it and/or modify
 * it under the terms of the GNU General Public License version 2 and
 * only version 2 as published by the Free Software Foundation.
 *
 * This program is distributed in the hope that it will be useful,
 * but WITHOUT ANY WARRANTY; without even the implied warranty of
 * MERCHANTABILITY or FITNESS FOR A PARTICULAR PURPOSE.  See the
 * GNU General Public License for more details.
 */

/*---------------------------------------------------------------------------
 * This file is autogenerated file using gcdb parser. Please do not edit it.
 * Update input XML file to add a new entry or update variable in this file
 * VERSION = "1.0"
 *---------------------------------------------------------------------------*/
&mdss_mdp {
	dsi_rm72013_txd_wxga_video: qcom,mdss_dsi_rm72013_txd_wxga_video {
		qcom,mdss-dsi-panel-name = "rm72013 txd wxga video mode dsi panel";
		qcom,mdss-dsi-panel-controller = <&mdss_dsi0>;
		qcom,mdss-dsi-panel-type = "dsi_video_mode";
		qcom,mdss-dsi-panel-destination = "display_1";
		qcom,mdss-dsi-panel-framerate = <60>;
		qcom,mdss-dsi-virtual-channel-id = <0>;
		qcom,mdss-dsi-stream = <0>;
		qcom,mdss-dsi-panel-width = <800>;
		qcom,mdss-dsi-panel-height = <1280>;
		qcom,mdss-dsi-h-front-porch = <24>;
		qcom,mdss-dsi-h-back-porch = <132>;
		qcom,mdss-dsi-h-pulse-width = <4>;
		qcom,mdss-dsi-h-sync-skew = <0>;
		qcom,mdss-dsi-v-back-porch = <8>;
		qcom,mdss-dsi-v-front-porch = <8>;
		qcom,mdss-dsi-v-pulse-width = <4>;
		qcom,mdss-dsi-h-left-border = <0>;
		qcom,mdss-dsi-h-right-border = <0>;
		qcom,mdss-dsi-v-top-border = <0>;
		qcom,mdss-dsi-v-bottom-border = <0>;
		qcom,mdss-dsi-bpp = <24>;
		qcom,mdss-dsi-color-order = "rgb_swap_rgb";
		qcom,mdss-dsi-underflow-color = <0xff>;
		qcom,mdss-dsi-border-color = <0>;
		/*[BUGFIX]-Mod-BEGIN by SCDTABLET.jinghuang@tcl.com,08/03/2015,1059931*/
		/*modify power on sequence:reset after LP11.*/
		qcom,mdss-dsi-lp11-init = <1>;
		qcom,mdss-dsi-init-delay-us = <10000>;
		/*[BUGFIX]-Mod-END by SCDTABLET.jinghuang@tcl.com*/
	qcom,mdss-dsi-on-command = [
			15 01 00 00 00 00 02 50 77
			15 01 00 00 00 00 02 E1 66
			15 01 00 00 00 00 02 DC 67
			15 01 00 00 00 00 02 50 00
			15 01 00 00 00 00 02 58 33
			15 01 00 00 00 00 02 D9 40
			15 01 00 00 00 00 02 58 00
			39 01 00 00 00 00 03 F0 5A 5A 
			39 01 00 00 06 00 04 C3 40 00 28
			15 01 00 00 00 00 02 B0 00
			39 01 00 00 06 00 08 FA 1F 19 25 18 1F 1E 1A
			15 01 00 00 00 00 02 B0 07
			39 01 00 00 06 00 08 FA 17 13 19 25 20 26 2F
			15 01 00 00 00 00 02 B0 0E
			39 01 00 00 06 00 04 FA 2F 30 18
			15 01 00 00 00 00 02 B0 00
			39 01 00 00 06 00 08 FB 18 18 1F 20 14 18 1B
			15 01 00 00 00 00 02 B0 07
			39 01 00 00 06 00 08 FB 1D 10 22 26 23 28 27
			15 01 00 00 00 00 02 B0 0E
			39 01 00 00 06 00 04 FB 24 2B 17
			05 01 00 00 00 00 02 11 00
			05 01 00 00 C8 00 02 29 00
			];

        qcom,mdss-dsi-off-command = [
			05 01 00 00 0A 00 02 28 00
			05 01 00 00 32 00 02 10 00
			39 01 00 00 0A 00 03 F0 5A 5A
			39 01 00 00 0A 00 04 C3 40 00 20
			];

		qcom,mdss-dsi-on-command-state = "dsi_lp_mode";
		qcom,mdss-dsi-off-command-state = "dsi_lp_mode";
		qcom,mdss-dsi-h-sync-pulse = <1>;
		qcom,mdss-dsi-traffic-mode = "burst_mode";
		qcom,mdss-dsi-lane-map = "lane_map_0123";
		qcom,mdss-dsi-bllp-eof-power-mode;
		qcom,mdss-dsi-bllp-power-mode;
		qcom,mdss-dsi-lane-0-state;
		qcom,mdss-dsi-lane-1-state;
		qcom,mdss-dsi-lane-2-state;
		qcom,mdss-dsi-lane-3-state;
		qcom,mdss-dsi-panel-timings = [87 1C 12 00 40 44 16 1E 17 03 04 00];
		qcom,mdss-dsi-t-clk-post = <0x04>;
		qcom,mdss-dsi-t-clk-pre = <0x1B>;
		qcom,mdss-dsi-bl-min-level = <8>;
		qcom,mdss-dsi-bl-max-level = <255>;
		qcom,mdss-dsi-dma-trigger = "trigger_sw";
		qcom,mdss-dsi-mdp-trigger = "none";
		qcom,mdss-dsi-bl-pmic-control-type = "bl_ctrl_pwm";
		qcom,mdss-dsi-bl-pmic-pwm-frequency = <33>;
		qcom,mdss-dsi-bl-pmic-bank-select = <0>;
		qcom,mdss-dsi-pwm-gpio = <&pm8909_mpps 2 0>;
		qcom,mdss-dsi-reset-sequence = <1 15>, <0 15>, <1 15>;
		qcom,cont-splash-enabled;
        /*[PLATFORM]-Add-BEGIN by TCTSZ.yaohui.zeng,2015/07/02,add LCD ESD check function*/        
        qcom,esd-check-enabled;
        qcom,mdss-dsi-panel-status-check-mode = "reg_read";
        qcom,mdss-dsi-panel-status-command = [06 01 00 01 05 00 01 0A];
        qcom,mdss-dsi-panel-status-command-state = "dsi_lp_mode";
        qcom,mdss-dsi-panel-status-value = <0x9C>;
        /*[PLATFORM]-Add-BEGIN by TCTSZ.yaohui.zeng,2015/07/02 */
    };
};
