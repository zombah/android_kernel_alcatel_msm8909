/* Copyright (c) 2014, The Linux Foundation. All rights reserved.
 *
 * This program is free software; you can redistribute it and/or modify
 * it under the terms of the GNU General Public License version 2 and
 * only version 2 as published by the Free Software Foundation.
 *
 * This program is distributed in the hope that it will be useful,
 * but WITHOUT ANY WARRANTY; without even the implied warranty of
 * MERCHANTABILITY or FITNESS FOR A PARTICULAR PURPOSE.  See the
 * GNU General Public License for more details.
 */

/*---------------------------------------------------------------------------
 * This file is autogenerated file using gcdb parser. Please do not edit it.
 * Update input XML file to add a new entry or update variable in this file
 * VERSION = "1.0"
 *---------------------------------------------------------------------------*/
&mdss_mdp {
	dsi_hx8379c_fwvga_vid: qcom,mdss_dsi_hx8379c_fwvga_video_pixi445_tf_tdt {
		qcom,mdss-dsi-panel-name = "hx8379c video mode dsi panel";
		qcom,mdss-dsi-panel-controller = <&mdss_dsi0>;
		qcom,mdss-dsi-panel-type = "dsi_video_mode";
		qcom,mdss-dsi-panel-destination = "display_1";
		qcom,mdss-dsi-panel-framerate = <58>;
		qcom,mdss-dsi-virtual-channel-id = <0>;
		qcom,mdss-dsi-stream = <0>;
		qcom,mdss-dsi-panel-width = <480>;
		qcom,mdss-dsi-panel-height = <854>;
		qcom,mdss-dsi-h-front-porch = <68>;//fix RF failed
		qcom,mdss-dsi-h-back-porch = <66>;//fix RF failed
		qcom,mdss-dsi-h-pulse-width = <4>;
		qcom,mdss-dsi-h-sync-skew = <0>;
		qcom,mdss-dsi-v-back-porch = <9>;//Modify [There is a white line at the bottom] by ke.li@tcl.com
		qcom,mdss-dsi-v-front-porch = <22>;
		qcom,mdss-dsi-v-pulse-width = <2>;
		qcom,mdss-dsi-h-left-border = <0>;
		qcom,mdss-dsi-h-right-border = <0>;
		qcom,mdss-dsi-v-top-border = <0>;
		qcom,mdss-dsi-v-bottom-border = <0>;
		qcom,mdss-dsi-bpp = <24>;
		qcom,mdss-dsi-color-order = "rgb_swap_rgb";
		qcom,mdss-dsi-underflow-color = <0xff>;
		qcom,mdss-dsi-border-color = <0>;
		qcom,mdss-dsi-on-command = [
		
        	39 01 00 00 00 00 04 B9 FF 83 79
		//39 01 00 00 00 00 03 BA 51 93 
		39 01 00 00 00 00 11 B1 44 1C 1C 32 52 50 D0 FA 98
					80 38 38 F8 33 32 22

		39 01 00 00 00 00 0A B2 80 FE 0A 04 00 50 11 42 1D  
		39 01 00 00 00 00 0B B4 7E 6A 6E 6A 6E 6A 22 80 23 80
		39 01 00 00 00 00 05 C7 00 00 00 C0
		39 01 00 00 00 00 02 CC 02
		39 01 00 00 00 00 02 D2 77

		39 01 00 00 00 00 1E D3 00 00 00 00 00 08 08 32 10
					03 00 03 03 60 03 60 00 08 00
					08 65 44 07 08 47 07 08 37 09 
										     
		39 01 00 00 00 00 21 D5 18 18 19 19 18 18 20 21 24
					25 18 18 18 18 00 01 04 05 02
					03 06 07 18 18 18 18 18 18 18
					18 18 18
										
		39 01 00 00 00 00 21 D6 18 18 18 18 19 19 25 24 21
					20 18 18 18 18 05 04 01 00 03
					02 07 06 18 18 18 18 18 18 18
					18 18 18

		39 01 00 00 00 00 2B E0 00 00 04 0D 0D 3F 26 35 08
					0E 10 1A 12 17 19 17 17 08 14
					15 18 00 00 04 0D 0D 3F 26 35
					08 0E 10 1A 12 17 19 17 17 08
					14 15 18

		39 01 00 00 00 00 03 B6 3E 3E
		15 01 00 00 00 00 02 35 00
  
		05 01 00 00 78 00 02 11 00
		05 01 00 00 14 00 02 29 00
];
		qcom,mdss-dsi-off-command = [05 01 00 00 02 00 02 28 00
					05 01 00 00 79 00 02 10 00];
		qcom,mdss-dsi-on-command-state = "dsi_lp_mode";
		qcom,mdss-dsi-off-command-state = "dsi_hs_mode";
		qcom,mdss-dsi-h-sync-pulse = <1>;
		qcom,mdss-dsi-traffic-mode = <2>;//"burst_mode";
		qcom,mdss-dsi-lane-map =<0>; //"lane_map_0123";//modify by yusen.ke.sz@tcl.com at 20140714 for lcd driver
		qcom,mdss-dsi-bllp-eof-power-mode;
		qcom,mdss-dsi-bllp-power-mode;
		qcom,mdss-dsi-lane-0-state;
		qcom,mdss-dsi-lane-1-state;
//		qcom,mdss-dsi-lane-2-state;
//		qcom,mdss-dsi-lane-3-state;
		qcom,mdss-dsi-panel-timings = [D5 18 10 00 38 3E 12 1A 13 03 04 00];
		qcom,mdss-dsi-t-clk-post = <0x05>;
		qcom,mdss-dsi-t-clk-pre = <0x36>;
		//qcom,mdss-dsi-panel-clockrate = <383000000>;//modify by yusen.ke.sz@tcl.com at 20141024 for fix cts test failed
		qcom,mdss-dsi-bl-min-level = <1>;
		qcom,mdss-dsi-bl-max-level = <255>;
		qcom,mdss-dsi-dma-trigger = <4>;//"trigger_sw";
		qcom,mdss-dsi-mdp-trigger = <0>;//"none";
		qcom,mdss-dsi-bl-pmic-control-type = "bl_ctrl_gpio";
		qcom,mdss-dsi-reset-sequence = <1 5>, <0 10>, <1 120>;
		qcom,mdss-pan-physical-width-dimension = <0>;
		qcom,mdss-pan-physical-height-dimension = <0>;
		qcom,esd-check-enabled;
		qcom,mdss-dsi-panel-status-command = [
		14 01 00 01 05 00 02 0a 00
		];
		qcom,mdss-dsi-panel-status-command-state = "dsi_lp_mode";
		qcom,mdss-dsi-panel-status-check-mode = "reg_read";
		qcom,mdss-dsi-panel-status-value = <0x1C>;
		qcom,mdss-dsi-post-init-delay = <2>;
	};
};
